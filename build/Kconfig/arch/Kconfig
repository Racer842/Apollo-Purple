## build/Kconfig/arch/Kconfig
```kconfig
# Load Zephyr Arch Kconfig descriptions.
osource "/Users/jakerussell/Documents/csse4011/zephyr/arch/x86/Kconfig"
osource "/Users/jakerussell/Documents/csse4011/zephyr/arch/xtensa/Kconfig"
osource "/Users/jakerussell/Documents/csse4011/zephyr/arch/sparc/Kconfig"
osource "/Users/jakerussell/Documents/csse4011/zephyr/arch/riscv/Kconfig"
osource "/Users/jakerussell/Documents/csse4011/zephyr/arch/posix/Kconfig"
osource "/Users/jakerussell/Documents/csse4011/zephyr/arch/nios2/Kconfig"
osource "/Users/jakerussell/Documents/csse4011/zephyr/arch/mips/Kconfig"
osource "/Users/jakerussell/Documents/csse4011/zephyr/arch/arm64/Kconfig"
osource "/Users/jakerussell/Documents/csse4011/zephyr/arch/arm/Kconfig"
osource "/Users/jakerussell/Documents/csse4011/zephyr/arch/arc/Kconfig"
```

## build/Kconfig/boards/Kconfig.defconfig
```kconfig
# Load Zephyr board defconfig descriptions.
osource "/Users/jakerussell/Documents/csse4011/zephyr/boards/m5stack/m5stack_core2/Kconfig.defconfig"
```

## build/Kconfig/boards/Kconfig.m5stack_core2
```kconfig
# Load board Kconfig descriptions.
osource "/Users/jakerussell/Documents/csse4011/zephyr/boards/m5stack/m5stack_core2/Kconfig.m5stack_core2"
```

## build/Kconfig/boards/Kconfig.sysbuild
```kconfig
# Load Sysbuild board Kconfig descriptions.
osource "/Users/jakerussell/Documents/csse4011/zephyr/boards/m5stack/m5stack_core2/Kconfig.sysbuild"
```

## build/Kconfig/soc/Kconfig
```kconfig
# Load Zephyr SoC Kconfig descriptions.
osource "/Users/jakerussell/Documents/csse4011/zephyr/soc/xlnx/zynqmp/Kconfig"
osource "/Users/jakerussell/Documents/csse4011/zephyr/soc/xlnx/zynq7000/Kconfig"
osource "/Users/jakerussell/Documents/csse4011/zephyr/soc/xen/Kconfig"
osource "/Users/jakerussell/Documents/csse4011/zephyr/soc/wch/ch32v/Kconfig"
osource "/Users/jakerussell/Documents/csse4011/zephyr/soc/ti/simplelink/Kconfig"
osource "/Users/jakerussell/Documents/csse4011/zephyr/soc/ti/lm3s6965/Kconfig"
osource "/Users/jakerussell/Documents/csse4011/zephyr/soc/ti/k3/Kconfig"
osource "/Users/jakerussell/Documents/csse4011/zephyr/soc/telink/tlsr/Kconfig"
osource "/Users/jakerussell/Documents/csse4011/zephyr/soc/starfive/jh71xx/Kconfig"
osource "/Users/jakerussell/Documents/csse4011/zephyr/soc/st/stm32/Kconfig"
osource "/Users/jakerussell/Documents/csse4011/zephyr/soc/snps/qemu_arc/Kconfig"
osource "/Users/jakerussell/Documents/csse4011/zephyr/soc/snps/nsim/arc_v/Kconfig"
osource "/Users/jakerussell/Documents/csse4011/zephyr/soc/snps/nsim/arc_classic/Kconfig"
osource "/Users/jakerussell/Documents/csse4011/zephyr/soc/snps/hsdk4xd/Kconfig"
osource "/Users/jakerussell/Documents/csse4011/zephyr/soc/snps/hsdk/Kconfig"
osource "/Users/jakerussell/Documents/csse4011/zephyr/soc/snps/emsk/Kconfig"
osource "/Users/jakerussell/Documents/csse4011/zephyr/soc/snps/emsdp/Kconfig"
osource "/Users/jakerussell/Documents/csse4011/zephyr/soc/snps/arc_iot/Kconfig"
osource "/Users/jakerussell/Documents/csse4011/zephyr/soc/silabs/Kconfig"
osource "/Users/jakerussell/Documents/csse4011/zephyr/soc/sifive/sifive_freedom/Kconfig"
osource "/Users/jakerussell/Documents/csse4011/zephyr/soc/sensry/Kconfig"
osource "/Users/jakerussell/Documents/csse4011/zephyr/soc/rockchip/Kconfig"
osource "/Users/jakerussell/Documents/csse4011/zephyr/soc/renode/riscv_virtual/Kconfig"
osource "/Users/jakerussell/Documents/csse4011/zephyr/soc/renode/cortex_r8_virtual/Kconfig"
osource "/Users/jakerussell/Documents/csse4011/zephyr/soc/renesas/smartbond/Kconfig"
osource "/Users/jakerussell/Documents/csse4011/zephyr/soc/renesas/rzt2m/Kconfig"
osource "/Users/jakerussell/Documents/csse4011/zephyr/soc/renesas/rz/Kconfig"
osource "/Users/jakerussell/Documents/csse4011/zephyr/soc/renesas/rcar/Kconfig"
osource "/Users/jakerussell/Documents/csse4011/zephyr/soc/renesas/ra/Kconfig"
osource "/Users/jakerussell/Documents/csse4011/zephyr/soc/realtek/ec/Kconfig"
osource "/Users/jakerussell/Documents/csse4011/zephyr/soc/raspberrypi/rpi_pico/Kconfig"
osource "/Users/jakerussell/Documents/csse4011/zephyr/soc/quicklogic/eos_s3/Kconfig"
osource "/Users/jakerussell/Documents/csse4011/zephyr/soc/qemu/virt_riscv/Kconfig"
osource "/Users/jakerussell/Documents/csse4011/zephyr/soc/qemu/malta/Kconfig"
osource "/Users/jakerussell/Documents/csse4011/zephyr/soc/openisa/rv32m1/Kconfig"
osource "/Users/jakerussell/Documents/csse4011/zephyr/soc/nxp/s32/Kconfig"
osource "/Users/jakerussell/Documents/csse4011/zephyr/soc/nxp/rw/Kconfig"
osource "/Users/jakerussell/Documents/csse4011/zephyr/soc/nxp/mcx/Kconfig"
osource "/Users/jakerussell/Documents/csse4011/zephyr/soc/nxp/lpc/Kconfig"
osource "/Users/jakerussell/Documents/csse4011/zephyr/soc/nxp/layerscape/Kconfig"
osource "/Users/jakerussell/Documents/csse4011/zephyr/soc/nxp/kinetis/Kconfig"
osource "/Users/jakerussell/Documents/csse4011/zephyr/soc/nxp/imxrt/Kconfig"
osource "/Users/jakerussell/Documents/csse4011/zephyr/soc/nxp/imx/Kconfig"
osource "/Users/jakerussell/Documents/csse4011/zephyr/soc/nuvoton/numicro/Kconfig"
osource "/Users/jakerussell/Documents/csse4011/zephyr/soc/nuvoton/numaker/Kconfig"
osource "/Users/jakerussell/Documents/csse4011/zephyr/soc/nuvoton/npcx/Kconfig"
osource "/Users/jakerussell/Documents/csse4011/zephyr/soc/nuvoton/npcm/Kconfig"
osource "/Users/jakerussell/Documents/csse4011/zephyr/soc/nordic/Kconfig"
osource "/Users/jakerussell/Documents/csse4011/zephyr/soc/neorv32/Kconfig"
osource "/Users/jakerussell/Documents/csse4011/zephyr/soc/native/inf_clock/Kconfig"
osource "/Users/jakerussell/Documents/csse4011/zephyr/soc/microchip/miv/Kconfig"
osource "/Users/jakerussell/Documents/csse4011/zephyr/soc/microchip/mec/Kconfig"
osource "/Users/jakerussell/Documents/csse4011/zephyr/soc/mediatek/mt8xxx/Kconfig"
osource "/Users/jakerussell/Documents/csse4011/zephyr/soc/lowrisc/opentitan/Kconfig"
osource "/Users/jakerussell/Documents/csse4011/zephyr/soc/litex/litex_vexriscv/Kconfig"
osource "/Users/jakerussell/Documents/csse4011/zephyr/soc/ite/ec/Kconfig"
osource "/Users/jakerussell/Documents/csse4011/zephyr/soc/intel/raptor_lake/Kconfig"
osource "/Users/jakerussell/Documents/csse4011/zephyr/soc/intel/lakemont/Kconfig"
osource "/Users/jakerussell/Documents/csse4011/zephyr/soc/intel/intel_socfpga_std/Kconfig"
osource "/Users/jakerussell/Documents/csse4011/zephyr/soc/intel/intel_socfpga/Kconfig"
osource "/Users/jakerussell/Documents/csse4011/zephyr/soc/intel/intel_niosv/Kconfig"
osource "/Users/jakerussell/Documents/csse4011/zephyr/soc/intel/intel_ish/Kconfig"
osource "/Users/jakerussell/Documents/csse4011/zephyr/soc/intel/intel_adsp/Kconfig"
osource "/Users/jakerussell/Documents/csse4011/zephyr/soc/intel/elkhart_lake/Kconfig"
osource "/Users/jakerussell/Documents/csse4011/zephyr/soc/intel/atom/Kconfig"
osource "/Users/jakerussell/Documents/csse4011/zephyr/soc/intel/apollo_lake/Kconfig"
osource "/Users/jakerussell/Documents/csse4011/zephyr/soc/intel/alder_lake/Kconfig"
osource "/Users/jakerussell/Documents/csse4011/zephyr/soc/infineon/cat3/Kconfig"
osource "/Users/jakerussell/Documents/csse4011/zephyr/soc/infineon/cat1b/Kconfig"
osource "/Users/jakerussell/Documents/csse4011/zephyr/soc/infineon/cat1a/Kconfig"
osource "/Users/jakerussell/Documents/csse4011/zephyr/soc/gd/gd32/Kconfig"
osource "/Users/jakerussell/Documents/csse4011/zephyr/soc/gaisler/leon3/Kconfig"
osource "/Users/jakerussell/Documents/csse4011/zephyr/soc/gaisler/gr716a/Kconfig"
osource "/Users/jakerussell/Documents/csse4011/zephyr/soc/espressif/Kconfig"
osource "/Users/jakerussell/Documents/csse4011/zephyr/soc/ene/kb1200/Kconfig"
osource "/Users/jakerussell/Documents/csse4011/zephyr/soc/efinix/sapphire/Kconfig"
osource "/Users/jakerussell/Documents/csse4011/zephyr/soc/cdns/xtensa_sample_controller/Kconfig"
osource "/Users/jakerussell/Documents/csse4011/zephyr/soc/cdns/sample_controller32/Kconfig"
osource "/Users/jakerussell/Documents/csse4011/zephyr/soc/cdns/dc233c/Kconfig"
osource "/Users/jakerussell/Documents/csse4011/zephyr/soc/brcm/bcmvk/Kconfig"
osource "/Users/jakerussell/Documents/csse4011/zephyr/soc/brcm/bcm2712/Kconfig"
osource "/Users/jakerussell/Documents/csse4011/zephyr/soc/brcm/bcm2711/Kconfig"
osource "/Users/jakerussell/Documents/csse4011/zephyr/soc/atmel/sam0/Kconfig"
osource "/Users/jakerussell/Documents/csse4011/zephyr/soc/atmel/sam/Kconfig"
osource "/Users/jakerussell/Documents/csse4011/zephyr/soc/aspeed/Kconfig"
osource "/Users/jakerussell/Documents/csse4011/zephyr/soc/arm/Kconfig"
osource "/Users/jakerussell/Documents/csse4011/zephyr/soc/arm/beetle/Kconfig"
osource "/Users/jakerussell/Documents/csse4011/zephyr/soc/antmicro/myra/Kconfig"
osource "/Users/jakerussell/Documents/csse4011/zephyr/soc/andestech/Kconfig"
osource "/Users/jakerussell/Documents/csse4011/zephyr/soc/amd/acp_6_0/Kconfig"
osource "/Users/jakerussell/Documents/csse4011/zephyr/soc/ambiq/Kconfig"
osource "/Users/jakerussell/Documents/csse4011/zephyr/soc/altr/zephyr_nios2f/Kconfig"
osource "/Users/jakerussell/Documents/csse4011/zephyr/soc/altr/qemu_nios2/Kconfig"
osource "/Users/jakerussell/Documents/csse4011/zephyr/soc/adi/max32/Kconfig"
```
